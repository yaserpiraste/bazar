## images/tttttttuyghjgjkgjkgjkg/hello_world/west.yml
```yaml
manifest:
  remotes:
    - name: ncs
      url-base: https://github.com/nrfconnect
  projects:
    - name: sdk-nrf
      remote: ncs
      path: nrf
      revision: v1.9.99-dev1
      import: true
      clone-depth: 1
  self:
    path: hello_world
```
